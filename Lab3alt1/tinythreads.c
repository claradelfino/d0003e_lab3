#include <setjmp.h>
#include <avr/io.h>
#include <avr/interrupt.h>
#include "tinythreads.h"
#include <stdbool.h>


#define NULL            0
#define DISABLE()       cli()
#define ENABLE()        sei()
#define STACKSIZE       80
#define NTHREADS        4
#define SETSTACK(buf,a) *((unsigned int *)(buf)+8) = (unsigned int)(a) + STACKSIZE - 4; \
*((unsigned int *)(buf)+9) = (unsigned int)(a) + STACKSIZE - 4

struct thread_block {
	void (*function)(int);   // code to run
	int arg;                 // argument to the above
	thread next;             // for use in linked lists
	jmp_buf context;         // machine state
	char stack[STACKSIZE];   // execution stack space
};

struct thread_block threads[NTHREADS];

struct thread_block initp;

thread freeQ   = threads;
thread readyQ  = NULL;
thread current = &initp;

int initialized = 0;

static void initialize(void) {
	int i;
	for (i=0; i<NTHREADS-1; i++)
	threads[i].next = &threads[i+1];
	threads[NTHREADS-1].next = NULL;
	
	initialized = 1;
	
	
	//enable the joystick
	PORTB = (1<<PB7);
	
	//enable the first interrupt
	EIMSK = 0x80;
	PCMSK1 = 0x80;
	

	TCCR1A = 0xC0;
	TCCR1B = 0x18;



	// Timer
	TCCR1A = (1 << COM1A1) | (1 << COM1A0);
	TCCR1B = (1 << WGM12) | (1 << CS12) | (1 << CS10);
	TIMSK1 = (1 << OCIE1A);
	OCR1A = 390;
	TCNT1 = 0;
}

static void enqueue(thread p, thread *queue) {
	p->next = NULL;
	if (*queue == NULL) {
		*queue = p;
		} else {
		thread q = *queue;
		
		while (q->next)
		q = q->next;
		q->next = p;
	}
}

static thread dequeue(thread *queue) {
	thread p = *queue;
	if (*queue) {
		*queue = (*queue)->next;
		} else {
		// Empty queue, kernel panic!!!
		while (1) ;  // not much else to do...
	}
	return p;
}

static void dispatch(thread next) {
	if (setjmp(current->context) == 0) {
		current = next;
		longjmp(next->context,1);
	}
}

void spawn(void (* function)(int), int arg) {
	thread newp;

	DISABLE();
	if (!initialized) initialize();

	newp = dequeue(&freeQ);
	newp->function = function;
	newp->arg = arg;
	newp->next = NULL;
	if (setjmp(newp->context) == 1) {
		ENABLE();
		current->function(current->arg);
		DISABLE();
		enqueue(current, &freeQ);
		dispatch(dequeue(&readyQ));
	}
	SETSTACK(&newp->context, &newp->stack);

	enqueue(newp, &readyQ);
	ENABLE();
}
/* As a stepping stone, start by installing a handler for the PCINT1_vect interrupt
(vector no.3), and let that handler cause the involutary yield.
A PCINT1_vect interrupt can be generated by pressing the Butterfly joystick
in the downward direction, if the logical interrupt source PCINT15 is enabled
in mask registers EIMSK and PCMSK1. PCINT15 corresponds to a change on pin 7 of PORTB.
*/

ISR(PCINT1_vect) {
	if((PINB >> 7) == 0) {
		yield();
	}
}

ISR(TIMER1_COMPA_vect) {
	yield();
}
/*A call to yield() shall place the calling thread in the last position
of the ready-queue, and then pick the first element of that queue for execution
(by means of the statement dispatch(dequeue(&readyQ)).
*/

void yield(void) {
	DISABLE();
	enqueue(current, &readyQ);
	dispatch(dequeue(&readyQ));
	ENABLE();
}


//A call to lock() shall set the locked flag
//of the mutex if it was previously unlocked,
//otherwise the running thread shall be placed
//in the waiting queue of the mutex and a new
//thread should be dispatched from the ready queue.


void lock(mutex *m) {
	DISABLE();
	//if it is unlocked, change to locked
	if(m->locked == 0) {
		m->locked = 1;
		} else {
		//current thread is added to the line
		enqueue(current, &m->waitQ);
		//run the first thread in the line
		dispatch(dequeue(&readyQ));
	}
	ENABLE();
}

// Calling unlock() shall activate a thread
// in the waiting queue of the mutex if it
// is non-empty, otherwise the locked flag
// shall be reset.

void unlock(mutex *m) {
	DISABLE();
	if(m->waitQ != NULL) {
		// if the waiting queue is non-empty activate the thread
		enqueue(current, &readyQ);
		dispatch(dequeue(&m->waitQ));
		} else {
		// if the waiting queue is empty, reset the flag
		m->locked = 0;
	}
	ENABLE();
}